## sdkconfig.defaults.atomclaw
```kconfig
# AtomClaw SDK config overrides for ESP32-S3 8MB Flash

# Build variant (Kconfig choice in main/Kconfig.projbuild)
CONFIG_DEVICE_ATOMCLAW=y

CONFIG_IDF_TARGET="esp32s3"

# Flash: 8MB QIO
CONFIG_ESPTOOLPY_FLASHSIZE_8MB=y
CONFIG_ESPTOOLPY_FLASHSIZE="8MB"
CONFIG_ESPTOOLPY_FLASHMODE_QIO=y
CONFIG_ESPTOOLPY_FLASHFREQ_80M=y

# Partition table
CONFIG_PARTITION_TABLE_CUSTOM=y
CONFIG_PARTITION_TABLE_CUSTOM_FILENAME="partitions_atomclaw.csv"

# CPU
CONFIG_ESP32S3_DEFAULT_CPU_FREQ_240=y

# PSRAM: 8MB Octal
CONFIG_SPIRAM=y
CONFIG_SPIRAM_MODE_OCT=y
CONFIG_SPIRAM_SPEED_80M=y
CONFIG_SPIRAM_USE_MALLOC=y
CONFIG_SPIRAM_MALLOC_ALWAYSINTERNAL=16384
CONFIG_SPIRAM_MALLOC_RESERVE_INTERNAL=32768

# Disable OTA (no OTA for AtomClaw)
CONFIG_APP_UPDATE_ENABLED=n

# Disable WebSocket (not needed for AtomClaw)
CONFIG_HTTPD_WS_SUPPORT=n

# mbedTLS: minimize buffer sizes for 8MB Flash target
CONFIG_MBEDTLS_SSL_IN_CONTENT_LEN=4096
CONFIG_MBEDTLS_SSL_OUT_CONTENT_LEN=4096
CONFIG_MBEDTLS_DYNAMIC_BUFFER=y
CONFIG_MBEDTLS_DYNAMIC_FREE_PEER_CERT=y
CONFIG_MBEDTLS_DYNAMIC_FREE_CONFIG_DATA=y

# Enable PSA Crypto (for Ed25519 verification)
# PSA_ECC_FAMILY_TWISTED_EDWARDS (Ed25519) requires both of these:
CONFIG_MBEDTLS_PSA_CRYPTO_C=y
CONFIG_MBEDTLS_ECP_DP_CURVE25519_ENABLED=y

# WiFi: reduce buffers
CONFIG_ESP_WIFI_STATIC_RX_BUFFER_NUM=4
CONFIG_ESP_WIFI_DYNAMIC_RX_BUFFER_NUM=8
CONFIG_ESP32_WIFI_TX_BUFFER_TYPE_DYNAMIC=y

# USB Serial JTAG console
CONFIG_ESP_CONSOLE_USB_SERIAL_JTAG=y
CONFIG_ESP_CONSOLE_SECONDARY_NONE=y

# Disable coredump (save Flash)
CONFIG_ESP_COREDUMP_ENABLE=n

# Timezone support
CONFIG_SNTP_TIME_SYNC_METHOD_SMOOTH=y

# Log level: reduce for production
CONFIG_LOG_DEFAULT_LEVEL_INFO=y
```
